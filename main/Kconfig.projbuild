## main/Kconfig.projbuild
```kconfig
menu "Presence Detector Configuration"

    menu "WiFi Configuration"
        config WIFI_SSID
            string "WiFi SSID"
            default "your_ssid"
            help
                SSID (network name) to connect to.

        config WIFI_PASSWORD
            string "WiFi Password"
            default "your_password"
            help
                WiFi password (WPA or WPA2).
    endmenu

    menu "MQTT Configuration"
        config MQTT_BROKER_URI
            string "MQTT Broker URI"
            default "mqtt://broker_ip:1883"
            help
                URI of the MQTT broker (e.g., mqtt://192.168.1.100:1883)

        config MQTT_USERNAME
            string "MQTT Username"
            default "mqtt_user"
            help
                Username for MQTT broker authentication.

        config MQTT_PASSWORD
            string "MQTT Password"
            default "mqtt_pass"
            help
                Password for MQTT broker authentication.

        config MQTT_TOPIC_SCAN_REQUEST
            string "MQTT Topic - Scan Request"
            default "home/presence/scan/request"
            help
                Topic to subscribe for scan trigger requests.

        config MQTT_TOPIC_PRESENCE_BASE
            string "MQTT Topic - Presence Base"
            default "home/presence"
            help
                Base topic for presence state publishing.
    endmenu

    menu "Presence Detection Settings"
        config BT_PROBE_TIMEOUT_MS
            int "Probe Timeout (ms)"
            default 8000
            help
                Timeout for SDP probe in milliseconds.

        config BT_INTER_DEVICE_DELAY_MS
            int "Inter-device Delay (ms)"
            default 300
            help
                Delay between probing different devices.

        config BT_MIN_SCAN_INTERVAL_MS
            int "Minimum Scan Interval (ms)"
            default 2000
            help
                Minimum interval between scan cycles.

        config BT_PAIRING_MODE
            bool "Enable Pairing Mode"
            default n
            help
                Enable pairing mode to discover and bond with phones.
                Disable after pairing is complete.
    endmenu

endmenu
```

## sdkconfig.defaults
```kconfig
# Bluetooth Configuration
CONFIG_BT_ENABLED=y
CONFIG_BT_BLUEDROID_ENABLED=y
CONFIG_BT_CLASSIC_ENABLED=y
CONFIG_BT_BLE_ENABLED=n
CONFIG_BT_SSP_ENABLED=y
CONFIG_BT_GAP_ENABLED=y

# Bluetooth Controller
CONFIG_BTDM_CTRL_MODE_BR_EDR_ONLY=y
CONFIG_BTDM_CTRL_BR_EDR_MAX_ACL_CONN=2
CONFIG_BTDM_CTRL_BR_EDR_MAX_SYNC_CONN=0

# WiFi Configuration
CONFIG_ESP_WIFI_MODE_STA=y

# TLS/SSL Certificate Bundle (for mqtts:// support)
CONFIG_MBEDTLS_CERTIFICATE_BUNDLE=y
CONFIG_MBEDTLS_CERTIFICATE_BUNDLE_DEFAULT_FULL=y

# WiFi/BT Coexistence
CONFIG_SW_COEXIST_ENABLE=y

# FreeRTOS
CONFIG_FREERTOS_HZ=1000

# Log Level
CONFIG_LOG_DEFAULT_LEVEL_INFO=y
CONFIG_LOG_DEFAULT_LEVEL=3

# Flash Size
CONFIG_ESPTOOLPY_FLASHSIZE_4MB=y

# Partition Table - Custom with larger app partition
CONFIG_PARTITION_TABLE_CUSTOM=y
CONFIG_PARTITION_TABLE_CUSTOM_FILENAME="partitions.csv"
CONFIG_PARTITION_TABLE_FILENAME="partitions.csv"
```
